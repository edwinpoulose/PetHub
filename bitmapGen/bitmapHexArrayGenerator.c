// This program generates hex array for picture Bitmap
// Each value in the array represents the 8bit column in a page, Ex: 128 byte array is a full page
// A page is 8 rows in oled (8 in total making 64 lines)

#include <stdio.h>
#include <math.h>
# define PAGEHEIGHT 8 //Fixed for SSD130x oleds
# define WIDTH 128 // can be 1 to 128/132


int main() {
    // Each ones and zeros represent the pixel in OLED
    int matrix[PAGEHEIGHT][WIDTH] = {
        
		// first page of logo
0,0,0,0,0,0,0,0,0,0,0,0,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0
,0,0,0,0,0,0,0,0,0,0,0,0,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0
,0,0,0,0,0,0,0,0,0,0,0,0,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0
,0,0,0,0,0,0,0,0,0,0,0,0,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0
,0,0,0,0,0,0,0,0,0,0,0,0,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0
,0,0,0,0,0,0,0,0,0,0,0,0,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0
,0,0,0,0,0,0,0,0,0,0,0,0,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0
,0,0,0,0,0,0,0,0,0,0,0,0,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0


    };


    int transpose[WIDTH][PAGEHEIGHT];

    // Display the original matrix
    printf("Original Matrix:\n");
    for (int i = 0; i < PAGEHEIGHT; i++) {
        for (int j = 0; j < WIDTH; j++) {
            printf("%d\t", matrix[i][j]);
        }
        printf("\n");
    }

    // Perform the transpose operation
    for (int i = 0; i < PAGEHEIGHT; i++) {
        for (int j = 0; j <WIDTH; j++) {
            transpose[j][i] = matrix[7-i][j]; 
        }
    }
    int value;
    // Display the transposed matrix
    printf("\nTransposed Matrix:\n");
    for (int i = 0; i < WIDTH; i++) {
        for (int j = 0; j < PAGEHEIGHT; j++) {
            printf("%x", transpose[i][j]);
        }
        printf("\n");
    }
    printf("\nTransposed Matrix(Hex):\n");
    printf("{");
    for (int i = 0; i < WIDTH; i++) {
        value=0;
        for (int j = 0; j < PAGEHEIGHT; j++) {
            value+=pow(2,PAGEHEIGHT-1-j)*transpose[i][j];
        }
        printf("0x%02x,",value);
    }
        printf("}");

    return 0;
}
